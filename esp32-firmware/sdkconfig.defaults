## esp32-firmware/sdkconfig.defaults
```kconfig
# BroilerGuard sdkconfig.defaults
# These settings are auto-applied when you run: idf.py set-target esp32

# Enable HTTPS / TLS
CONFIG_ESP_TLS_USING_MBEDTLS=y
CONFIG_MBEDTLS_CERTIFICATE_BUNDLE=y
CONFIG_MBEDTLS_CERTIFICATE_BUNDLE_DEFAULT_FULL=y

# HTTP client
CONFIG_ESP_HTTP_CLIENT_ENABLE_HTTPS=y

# WiFi
CONFIG_ESP_WIFI_STATIC_RX_BUFFER_NUM=10
CONFIG_ESP_WIFI_DYNAMIC_RX_BUFFER_NUM=32

# Increase main task stack (needed for TLS)
CONFIG_ESP_MAIN_TASK_STACK_SIZE=8192

# Allow longer URLs
CONFIG_ESP_HTTP_CLIENT_MAX_URL_SIZE=512

CONFIG_MBEDTLS_CERTIFICATE_BUNDLE=y
CONFIG_MBEDTLS_CERTIFICATE_BUNDLE_DEFAULT_FULL=y

# Increase App Partition Size (for Camera & TLS)
CONFIG_PARTITION_TABLE_SINGLE_APP_LARGE=y
```
